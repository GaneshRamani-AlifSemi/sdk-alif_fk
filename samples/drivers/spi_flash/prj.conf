## CMakeLists.txt
```
# SPDX-License-Identifier: Apache-2.0

cmake_minimum_required(VERSION 3.20.0)
find_package(Zephyr REQUIRED HINTS $ENV{ZEPHYR_BASE})
project(spi_flash)

target_sources(app PRIVATE src/main.c)
target_include_directories(app PRIVATE ${ZEPHYR_BASE}/drivers/flash)
```

## prj.conf
```kconfig
# Copyright (C) 2026 Alif Semiconductor.
# SPDX-License-Identifier: Apache-2.0

CONFIG_STDOUT_CONSOLE=y
CONFIG_FLASH=y
CONFIG_IPM=y
CONFIG_ARM_MHUV2=y
CONFIG_LOG=y
CONFIG_EVENTS=y
CONFIG_MAIN_STACK_SIZE=8192
CONFIG_MSPI_XIP=y
#CONFIG_FLASH_LOG_LEVEL_DBG=y
```

## src/main.c
```c
/*
 * Copyright (c) 2024 Alif Semiconductor
 * SPDX-License-Identifier: Apache-2.0
 */

#include <stdio.h>
#include <string.h>
#include <zephyr/device.h>
#include <zephyr/devicetree.h>
#include <zephyr/drivers/flash.h>
#include <zephyr/kernel.h>

#include "flash_ospi_is25wx.h"

#define SPI_FLASH_TEST_REGION_OFFSET 0x0
#define SPI_FLASH_SECTOR_SIZE        4096
#define BUFF_SIZE                    1024

const struct flash_parameters *flash_param;

void single_sector_test(const struct device *flash_dev)
{
	const uint8_t expected[] = {0x55, 0xaa, 0x66, 0x99};
	const size_t len = ARRAY_SIZE(expected);
	uint8_t buf[len];
	int rc;
	int i, e_count = 0;

	printf("\nTest 1: Flash erase\n");

	/* Full flash erase if SPI_FLASH_TEST_REGION_OFFSET = 0 and
	 * SPI_FLASH_SECTOR_SIZE = flash size
	 */
	rc = flash_erase(flash_dev, SPI_FLASH_TEST_REGION_OFFSET, SPI_FLASH_SECTOR_SIZE);
	if (rc != 0) {
		printf("Flash erase failed! %d\n", rc);
	} else {
		printf("Flash erase succeeded!\n");
	}

	printf("\nTest 1: Flash write\n");

	printf("Attempting to write %zu bytes\n", len);
	rc = flash_write(flash_dev, SPI_FLASH_TEST_REGION_OFFSET, expected, len);
	if (rc != 0) {
		printf("Flash write failed! %d\n", rc);
		return;
	}

	printf("\nTest 1: Flash read\n");

	memset(buf, 0, len);
	rc = flash_read(flash_dev, SPI_FLASH_TEST_REGION_OFFSET, buf, len);
	if (rc != 0) {
		printf("Flash read failed! %d\n", rc);
		return;
	}

	for (i = 0; i < len; i++) {
		if (buf[i] != expected[i]) {
			e_count++;
			printf("Not matched at [%d] _w[%4x] _r[%4x]\n", i, expected[i], buf[i]);
		}
	}

	if (e_count) {
		printf("Error:Data read NOT matches data written\n");
	} else {
		printf("Data read matches data written. Good!!\n");
	}
}

void erase_test(const struct device *dev, uint32_t len)
{
	int ret = 0, i = 0, count = 0;
	uint8_t r_buf[BUFF_SIZE] = {0};

	printf("\nTest 2: Flash Full Erase\n");

	ret = flash_erase(dev, SPI_FLASH_TEST_REGION_OFFSET, len);
	if (ret == 0) {
		printf("Successfully Erased whole Flash Memory\n");
	} else {
		printf("Error: Bulk Erase Failed [%d]\n", ret);
	}

	/* Read data Cleared Buffer */
	ret = flash_read(dev, SPI_FLASH_TEST_REGION_OFFSET, r_buf, BUFF_SIZE);
	if (ret != 0) {
		printf("Error: [RetVal :%d] Reading Erased value\n", ret);
		return;
	}

	/* Verify the read data */
	for (i = 0; i < BUFF_SIZE; i++) {
		if (r_buf[i] != flash_param->erase_value) {
			count++;
		}
	}

	printf("Total errors after reading erased chip = %d\n", count);
}

void multi_page_test(const struct device *flash_dev)
{
	int rc, i, e_count = 0;

	uint8_t w_buf[BUFF_SIZE] = {0};
	uint8_t r_buf[BUFF_SIZE] = {0};

	const size_t len = ARRAY_SIZE(w_buf);

	printf("\nTest 3: Flash erase\n");

	/* Full flash erase if SPI_FLASH_TEST_REGION_OFFSET = 0 and
	 * SPI_FLASH_SECTOR_SIZE = flash size
	 */
	rc = flash_erase(flash_dev, SPI_FLASH_TEST_REGION_OFFSET, SPI_FLASH_SECTOR_SIZE);
	if (rc != 0) {
		printf("Flash erase failed! %d\n", rc);
	} else {
		printf("Flash erase succeeded!\n");
	}

	for (i = 0; i < BUFF_SIZE; i++) {
		w_buf[i] = i % 256;
	}

	printf("\nTest 3: Flash write\n");

	printf("Attempting to write %zu bytes\n", len);
	rc = flash_write(flash_dev, SPI_FLASH_TEST_REGION_OFFSET, w_buf, len);
	if (rc != 0) {
		printf("Flash write failed! %d\n", rc);
		return;
	}

	printf("\nTest 3: Flash read\n");

	memset(r_buf, 0, len);
	rc = flash_read(flash_dev, SPI_FLASH_TEST_REGION_OFFSET, r_buf, len);
	if (rc != 0) {
		printf("Flash read failed! %d\n", rc);
		return;
	}

	for (i = 0; i < BUFF_SIZE; i++) {
		if (r_buf[i] != w_buf[i]) {
			e_count++;
			printf("Not matched at [%d] _w[%4x] _r[%4x]\n", i, w_buf[i], r_buf[i]);
		}
	}

	if (e_count) {
		printf("Error:Data read NOT matches data written\n");
		printf(" -- number of Unmatched data [%d]\n", e_count);
	} else {
		printf("Data read matches data written. Good!!\n");
	}
}

#define SPI_FLASH_SECTOR_4_OFFSET (4 * 1024 * 4)
#define SPI_FLASH_SECTOR_5_OFFSET (5 * 1024 * 4)

void multi_sector_test(const struct device *flash_dev)
{
	int rc, i, e_count = 0;

	uint8_t w_buf[BUFF_SIZE] = {0};
	uint8_t r_buf[BUFF_SIZE] = {0};

	const size_t len = ARRAY_SIZE(w_buf);

	for (i = 0; i < BUFF_SIZE; i++) {
		w_buf[i] =  i % 256;
	}

	printf("\nTest 4: write sector %d\n", SPI_FLASH_SECTOR_4_OFFSET);
	/* Write into Sector 4 */
	rc = flash_write(flash_dev, SPI_FLASH_SECTOR_4_OFFSET, w_buf, len);
	if (rc != 0) {
		printf("\nFlash write failed at Sec 4! %d\n", rc);
		return;
	}

	printf("\nTest 4: write sector %d\n", SPI_FLASH_SECTOR_5_OFFSET);
	/* Write into Sector 5 */
	rc = flash_write(flash_dev, SPI_FLASH_SECTOR_5_OFFSET, w_buf, len);
	if (rc != 0) {
		printf("\nFlash write failed at Sec 5! %d\n", rc);
		return;
	}

	/* Read from Sector 4 */
	printf("Sec4: Read and Verify written data\n");

	e_count = 0;
	memset(r_buf, 0, len);

	printf("\nTest 4: read sector %d\n", SPI_FLASH_SECTOR_4_OFFSET);

	rc = flash_read(flash_dev, SPI_FLASH_SECTOR_4_OFFSET, r_buf, len);
	if (rc != 0) {
		printf("Flash read failed at Sector 4! %d\n", rc);
		return;
	}

	for (i = 0; i < BUFF_SIZE; i++) {
		if (r_buf[i] != w_buf[i]) {
			e_count++;
			printf("Not matched at [%d] _w[%4x] _r[%4x]\n", i, w_buf[i], r_buf[i]);
		}
	}

	if (e_count) {
		printf("\nError:Data read NOT matches data written\n");
		printf(" -- number of Unmatched data [%d]\n", e_count);
	} else {
		printf("\nData read matches data written. Good!!\n");
	}

	/* Read from Sector 5 */
	printf("Sec5: Read and Verify written data\n");

	e_count = 0;
	memset(r_buf, 0, len);

	printf("\nTest 4: read sector %d\n", SPI_FLASH_SECTOR_5_OFFSET);

	rc = flash_read(flash_dev, SPI_FLASH_SECTOR_5_OFFSET, r_buf, len);
	if (rc != 0) {
		printf("Flash read failed at Sector 5! %d\n", rc);
		return;
	}

	for (i = 0; i < BUFF_SIZE; i++) {
		if (r_buf[i] != w_buf[i]) {
			e_count++;
			printf("Not matched at [%d] _w[%4x] _r[%4x]\n", i, w_buf[i], r_buf[i]);
		}
	}

	if (e_count) {
		printf("Error:Data read NOT matches data written\n");
		printf(" -- number of Unmatched data [%d]\n", e_count);
	} else {
		printf("Data read matches data written. Good!!\n");
	}

	/* Erase multiple Sector Sec 4+5 */
	printf("\nTest 4: Erase Sector 4 and 5\n");
	printf("Flash Erase from Sector %d Size to Erase %d\n", SPI_FLASH_SECTOR_4_OFFSET,
	       SPI_FLASH_SECTOR_SIZE * 2);

	rc = flash_erase(flash_dev, SPI_FLASH_SECTOR_4_OFFSET, SPI_FLASH_SECTOR_SIZE * 2);
	if (rc != 0) {
		printf("\nMulti-Sector erase failed! %d\n", rc);
	} else {
		printf("\nMulti-Sector erase succeeded!\n");
	}

	int count_1 = 0;

	memset(r_buf, 0, len);

	printf("\nTest 4: read sector %d\n", SPI_FLASH_SECTOR_4_OFFSET);
	/* Read Erased value and compare */
	rc = flash_read(flash_dev, SPI_FLASH_SECTOR_4_OFFSET, r_buf, BUFF_SIZE);
	if (rc != 0) {
		printf("Error: [RetVal :%d] Reading Erased value\n", rc);
		return;
	}

	/* Verify the read data */
	for (i = 0; i < BUFF_SIZE; i++) {
		if (r_buf[i] != flash_param->erase_value) {
			count_1++;
		}
	}

	printf("Total errors after reading erased Sector 4 = %d\n", count_1);

	int count_2 = 0;

	memset(r_buf, 0, len);
	printf("\nTest 4: read sector %d\n", SPI_FLASH_SECTOR_5_OFFSET);

	/* Read Erased value and compare */
	rc = flash_read(flash_dev, SPI_FLASH_SECTOR_5_OFFSET, r_buf, BUFF_SIZE);
	if (rc != 0) {
		printf("Error: [RetVal :%d] Reading Erased value\n", rc);
		return;
	}

	/* Verify the read data */
	for (i = 0; i < BUFF_SIZE; i++) {
		if (r_buf[i] != flash_param->erase_value) {
			count_2++;
		}
	}

	printf("Total errors after reading erased Sector 5 = %d\n", count_2);

	if (count_1 == 0 && count_2 == 0) {
		printf("\nMulti-Sector Erase Test Succeeded !\n");
	} else {
		printf("\nMulti-Sector Erase Failed\n");
	}
}

static void print_bytes(const char *label, const uint8_t *data, size_t len)
{
	printf("%s", label);
	for (size_t i = 0; i < len; i++) {
		printf(" %02x", data[i]);
	}
	printf("\n");
}

static int xip_read(const struct device *flash_dev, const uint8_t *xip_address,
		    uint8_t *data, size_t len)
{
	int rc;
	int unlock_rc;

	rc = flash_ospi_is25wx_xip_lock(flash_dev);
	if (rc != 0) {
		return rc;
	}

	memcpy(data, xip_address, len);

	unlock_rc = flash_ospi_is25wx_xip_unlock(flash_dev);
	return unlock_rc;
}

void xip_test(const struct device *flash_dev)
{
	static const uint8_t write_data[16] = {
		0x00, 0x11, 0x22, 0x33, 0x44, 0x55, 0x66, 0x77,
		0x88, 0x99, 0xaa, 0xbb, 0xcc, 0xdd, 0xee, 0xff,
	};
	uint8_t xip_data[sizeof(write_data)] = {0};
	uint8_t command_data[sizeof(write_data)] = {0};
	const uint8_t *xip_address =
		(const uint8_t *)DT_PROP_BY_IDX(DT_PARENT(DT_ALIAS(spi_flash0)),
						     xip_base_address, 0);
	int rc;

	printf("\nTest 5: Runtime XiP and command-mode access\n");

	/* 1. Read and print the initial contents through the XiP window. */
	rc = xip_read(flash_dev, xip_address, xip_data, sizeof(xip_data));
	if (rc != 0) {
		printf("Step 1: XiP read failed! %d\n", rc);
		return;
	}
	print_bytes("Step 1: XiP read:       ", xip_data, sizeof(xip_data));

	/* 2. Erase the destination sector, then program 16 bytes indirectly. */
	rc = flash_erase(flash_dev, SPI_FLASH_TEST_REGION_OFFSET, SPI_FLASH_SECTOR_SIZE);
	if (rc != 0) {
		printf("Step 2: Flash erase failed! %d\n", rc);
		return;
	}
	print_bytes("Step 2: Command write:  ", write_data, sizeof(write_data));
	rc = flash_write(flash_dev, SPI_FLASH_TEST_REGION_OFFSET,
			 write_data, sizeof(write_data));
	if (rc != 0) {
		printf("Step 2: Command write failed! %d\n", rc);
		return;
	}

	/* 3. Re-enter XiP, read back, print, and compare with the write data. */
	memset(xip_data, 0, sizeof(xip_data));
	rc = xip_read(flash_dev, xip_address, xip_data, sizeof(xip_data));
	if (rc != 0) {
		printf("Step 3: XiP read failed! %d\n", rc);
		return;
	}
	print_bytes("Step 3: XiP read:       ", xip_data, sizeof(xip_data));
	printf("Step 3: XiP compare %s\n",
	       memcmp(xip_data, write_data, sizeof(write_data)) == 0 ? "passed" : "failed");

	/* 4. Read the same 16 bytes using an indirect command and print them. */
	rc = flash_read(flash_dev, SPI_FLASH_TEST_REGION_OFFSET,
			command_data, sizeof(command_data));
	if (rc != 0) {
		printf("Step 4: Command read failed! %d\n", rc);
		return;
	}
	print_bytes("Step 4: Command read:   ", command_data, sizeof(command_data));

	/* 5. Re-enter XiP again and compare it with the command-mode read. */
	memset(xip_data, 0, sizeof(xip_data));
	rc = xip_read(flash_dev, xip_address, xip_data, sizeof(xip_data));
	if (rc != 0) {
		printf("Step 5: XiP read failed! %d\n", rc);
		return;
	}
	print_bytes("Step 5: XiP read:       ", xip_data, sizeof(xip_data));
	printf("Step 5: XiP/command compare %s\n",
	       memcmp(xip_data, command_data, sizeof(command_data)) == 0 ? "passed" : "failed");

	printf("Runtime XiP and command-mode test complete\n");
}


int main(void)
{
	const struct device *flash_dev = DEVICE_DT_GET(DT_ALIAS(spi_flash0));

	if (!device_is_ready(flash_dev)) {
		printk("%s: device not ready.\n", flash_dev->name);
		return -1;
	}

	printf("\n%s OSPI flash testing\n", flash_dev->name);
	printf("========================================\n");

	flash_param = flash_get_parameters(flash_dev);

	printf("****Flash Configured Parameters******\n");
	printf("* Num Of Sectors : %d\n", flash_param->num_of_sector);
	printf("* Sector Size : %d\n", flash_param->sector_size);
	printf("* Page Size : %d\n", flash_param->page_size);
	printf("* Erase value : %d\n", flash_param->erase_value);
	printf("* Write Blk Size: %d\n", flash_param->write_block_size);
	printf("* Total Size in MB: %d\n",
	       (flash_param->num_of_sector * flash_param->sector_size) / (1024 * 1024));

	/*Current RW support only on 16 DFS */
	single_sector_test(flash_dev);

	/* Erase Full and verify the content */
	erase_test(flash_dev, flash_param->num_of_sector * flash_param->sector_size);

	/* Multipage test */
	multi_page_test(flash_dev);

	/* Multi-Secot R/W and Erase test*/
	multi_sector_test(flash_dev);

	xip_test(flash_dev);

	return 0;
}
```

## src/ram_app.c
```c
/* Copyright (C) 2025 Alif Semiconductor - All Rights Reserved.
 * Use, distribution and modification of this code is permitted under the
 * terms stated in the Alif Semiconductor Software License Agreement
 *
 * You should have received a copy of the Alif Semiconductor Software
 * License Agreement with this file. If not, please write to:
 * contact@alifsemi.com, or visit: https://alifsemi.com/license
 */

#include <stdio.h>
#include <stdint.h>
#include <zephyr/device.h>
#include <zephyr/devicetree.h>
#include <zephyr/kernel.h>
#include <errno.h>

#if defined(CONFIG_SOC_SERIES_E7) || defined(CONFIG_SOC_SERIES_E5) || \
	defined(CONFIG_SOC_SERIES_E3) || defined(CONFIG_SOC_SERIES_E1)
#include <zephyr/arch/arm/mpu/arm_mpu.h>
#include <zephyr/cache.h>
#include <zephyr/sys/barrier.h>
#endif

#define PSRAM_NODE		DT_ALIAS(spi_psram)
#define OSPI_XIP_BASE		DT_PROP_BY_IDX(DT_PARENT(PSRAM_NODE), xip_base_address, 0)

#if defined(CONFIG_SOC_SERIES_E7) || defined(CONFIG_SOC_SERIES_E5) || \
	defined(CONFIG_SOC_SERIES_E3) || defined(CONFIG_SOC_SERIES_E1)
#define PSRAM_TEST_RUNTIME_MPU_ATTR	1
typedef uint16_t psram_data_t;
#else
#define PSRAM_TEST_RUNTIME_MPU_ATTR	0
#if defined(CONFIG_SOC_SERIES_B1)
typedef uint16_t psram_data_t;
#else
/**32b used in HexRAM */
typedef uint32_t psram_data_t;
#endif
#endif

static void print_test_config(uint32_t ram_size)
{
	printk("Test configuration:\n");
	printk("  XIP base        : 0x%x\n", (uint32_t)OSPI_XIP_BASE);
	printk("  RAM size        : %u bytes\n", ram_size);
	printk("  Access width    : %u-bit\n", sizeof(psram_data_t) * 8);
	printk("  Pattern         : incrementing %u-bit value, wraps at data width\n",
	       sizeof(psram_data_t) * 8);
#if PSRAM_TEST_RUNTIME_MPU_ATTR
	printk("  MPU test cases  : Device, Normal non-cacheable, SRAM cacheable\n");
#else
	printk("  MPU test cases  : Direct read/write, no runtime MPU changes\n");
#endif
}

static void print_test_case(const char *mode, const char *write_attr, const char *read_attr)
{
	printk("\nTest case: %s\n", mode);
	printk("  Write attribute : %s\n", write_attr);
	printk("  Read attribute  : %s\n", read_attr);
}

#if PSRAM_TEST_RUNTIME_MPU_ATTR
static int ospi_xip_set_mair_idx(uint8_t mair_idx, size_t cache_size)
{
	for (uint32_t region = 0; region < mpu_config.num_regions; region++) {
		const struct arm_mpu_region *mpu_region = &mpu_config.mpu_regions[region];

		if (mpu_region->base != OSPI_XIP_BASE) {
			continue;
		}

		unsigned int key = irq_lock();

		(void)sys_cache_data_flush_and_invd_range((void *)OSPI_XIP_BASE, cache_size);
		barrier_dsync_fence_full();
		ARM_MPU_SetRegion(region, OSPI_XIP_BASE | mpu_region->attr.rbar,
				  mpu_region->attr.r_limit |
					  (mair_idx << MPU_RLAR_AttrIndx_Pos) |
					  MPU_RLAR_EN_Msk);
		barrier_dsync_fence_full();
		barrier_isync_fence_full();
		irq_unlock(key);

		return 0;
	}

	return -ENOENT;
}
#endif

static uint32_t verify_pattern(const char *mode, volatile psram_data_t *ptr, uint32_t ram_size)
{
	uint32_t total_errors = 0;

	printk("Reading back in %s mode:\n", mode);

	for (uint32_t index = 0; index < (ram_size / sizeof(psram_data_t)); index++) {
		psram_data_t got = ptr[index];
		psram_data_t expected = (psram_data_t)index;

		if (got != expected) {
			printk("%s read error at addr %x, line_item %u, got %x, expected %x\n",
			       mode, (index * sizeof(psram_data_t)),
			       index & ((32 / sizeof(psram_data_t)) - 1),
			       got, expected);
			total_errors++;
			break;
		}
	}

	printk("%s total errors = %u\n", mode, total_errors);

	return total_errors;
}

int ram_app(void)
{
	const struct device *psram_dev = DEVICE_DT_GET(PSRAM_NODE);

	volatile psram_data_t *const ptr = (volatile psram_data_t *)OSPI_XIP_BASE;
	uint32_t ram_size;

	ram_size = DT_PROP(PSRAM_NODE, size);

	if (!device_is_ready(psram_dev)) {
		printk("%s: device not ready.\n", psram_dev->name);
		return -1;
	}

	printk("\nPSRAM XIP mode demo app started\n");
	print_test_config(ram_size);

#if PSRAM_TEST_RUNTIME_MPU_ATTR
	int ret;

	print_test_case("Device", "Device", "Device");

	ret = ospi_xip_set_mair_idx(MPU_MAIR_INDEX_DEVICE, ram_size);
	if (ret != 0) {
		printk("Failed to set OSPI XIP Device MPU attribute: %d\n", ret);
		return ret;
	}

	printk("Writing data to the XIP region:\n");

	for (uint32_t index = 0; index < (ram_size/sizeof(psram_data_t)); index++) {
		ptr[index] = (psram_data_t)index;
	}
	barrier_dsync_fence_full();

	(void)verify_pattern("Device", ptr, ram_size);

	print_test_case("Normal non-cacheable", "Device", "Normal non-cacheable");

	ret = ospi_xip_set_mair_idx(MPU_MAIR_INDEX_SRAM_NOCACHE, ram_size);
	if (ret != 0) {
		printk("Failed to set OSPI XIP Normal non-cacheable MPU attribute: %d\n", ret);
		return ret;
	}

	(void)verify_pattern("Normal non-cacheable", ptr, ram_size);

	print_test_case("SRAM cacheable", "Device", "SRAM cacheable");

	ret = ospi_xip_set_mair_idx(MPU_MAIR_INDEX_SRAM, ram_size);
	if (ret != 0) {
		printk("Failed to set OSPI XIP SRAM cacheable MPU attribute: %d\n", ret);
		return ret;
	}

	(void)verify_pattern("SRAM cacheable", ptr, ram_size);
#else
	print_test_case("Direct", "Default MPU/static attribute", "Default MPU/static attribute");

	printk("Writing data to the XIP region:\n");

	for (uint32_t index = 0; index < (ram_size/sizeof(psram_data_t)); index++) {
		ptr[index] = (psram_data_t)index;
	}

	(void)verify_pattern("Default", ptr, ram_size);
#endif

	printk("Done\n");

	return 0;
}
```
